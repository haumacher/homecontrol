## platform/esp/components/hc_image/Kconfig
```kconfig
# Copyright (c) 2026 Bernhard Haumacher

menu "HomeControl runtime image"

	config HC_IMAGE_LOAD_YIELD
		bool "Let the lower-priority tasks run between the phases of an image load"
		default y
		help
			An image load runs on the event loop for several hundred milliseconds, at the loop's
			priority. Meanwhile the tasks below it (the KNX socket's reader, mDNS, the E-Home sender,
			the console writer) cannot take what the network delivers to them, and every packet that
			waits for them holds a WiFi receive buffer of the heap: on the C6 about 20 KB in the first
			170 ms of a deploy (homecontrol #70). With this option the loop sleeps one tick at the end
			of each phase (about 20 phases, at most 10 ms each), so they drain what has arrived.

	config HC_IMAGE_HEAP_PHASES
		bool "Log the heap at each phase of an image load"
		default n
		help
			Logs, under hc.image at info level, the free heap and the lowest free heap of each phase
			of every image load: the parse (json, datapoints, schedules, history, ui), the rules'
			and the blocks' compilation, the model, the adoption of the rules and the blocks, the
			bindings, the start and the release of the old image (homecontrol #70, doc/image.md
			"Memory of a swap" lists them). Off, the same
			lines are logged at debug level: `log level hc.image debug` on the console switches them
			on without a rebuild.

	config HC_IMAGE_HEAP_BY_TASK
		bool "With the heap of each task (heap task tracking)"
		default n
		select HEAP_TASK_TRACKING
		help
			Adds to the load's last line and to the lines 3 s and 10 s after it every task whose heap
			changed by 256 B or more since the load began (heap_caps_get_per_task_info): what the
			load's own allocations do not explain, such as network buffers of tasks the load held
			back. Turns on the IDF's heap task tracking, which costs a few bytes per allocation and
			some speed: for measurements, not for production builds.

endmenu
```

## platform/esp/components/hc_net/Kconfig
```kconfig
# Copyright (c) 2026 Bernhard Haumacher

menu "HomeControl network"

	config HC_WPS_BUTTON_GPIO
		int "GPIO of the WPS button (active low; -1: no button)"
		range -1 48
		default 9 if IDF_TARGET_ESP32C6
		default 0 if IDF_TARGET_ESP32S3
		default -1
		help
			Holding this button for about 3 s starts WPS push-button provisioning. The default is
			the BOOT button of the Espressif devkits (GPIO9 on the ESP32-C6, GPIO0 on the
			ESP32-S3), a strapping pin that is read only after boot. The pin is configured as an
			input with the internal pull-up; pressed means low.

	config HC_WIFI_MAX_TX_POWER
		int "Maximum WiFi transmit power (quarter dBm, 8..84)"
		range 8 84
		default 80
		help
			Passed to esp_wifi_set_max_tx_power() when the station starts: 80 is 20 dBm, the
			driver's maximum; 44 is 11 dBm. A lower value saves supply current during
			transmit bursts: a board on a weak USB supply browns out at full power (the
			development C6 did, doc/hardware.md). Range check and lower values as the chip
			supports them; the driver rounds to the next supported step.

endmenu
```

## platform/esp/components/hc_status_light/Kconfig
```kconfig
# Copyright (c) 2026 Bernhard Haumacher

menu "HomeControl status LED"

	choice HC_STATUS_LED_KIND
		prompt "Status LED"
		default HC_STATUS_LED_WS2812 if IDF_TARGET_ESP32C6
		default HC_STATUS_LED_NONE
		help
			The LED that shows the controller's state (doc/network.md has the blink patterns), and
			the OTA updater's (doc/ota.md "The updater").
			The ESP32-C6-DevKitC-1 and -DevKitM-1 carry a WS2812 RGB LED on GPIO8.

		config HC_STATUS_LED_NONE
			bool "none"
		config HC_STATUS_LED_GPIO
			bool "plain LED on a GPIO"
		config HC_STATUS_LED_WS2812
			bool "WS2812 RGB LED (one pixel, driven over RMT)"
	endchoice

	config HC_STATUS_LED_GPIO_NUM
		int "Status LED GPIO"
		depends on !HC_STATUS_LED_NONE
		range 0 48
		default 8

	config HC_STATUS_LED_ACTIVE_LOW
		bool "Plain LED is lit when the GPIO is low"
		depends on HC_STATUS_LED_GPIO
		default n

endmenu
```

## platform/esp/components/hc_zigbee/Kconfig
```kconfig
# Copyright (c) 2026 Bernhard Haumacher

menu "HomeControl Zigbee"

	config HC_ZIGBEE_ENABLED
		bool "Zigbee coordinator"
		depends on SOC_IEEE802154_SUPPORTED && (IDF_TARGET_ESP32C6 || IDF_TARGET_ESP32H2)
		default y
		help
			The controller forms a Zigbee network as its coordinator on the chip's 802.15.4 radio
			(doc/zigbee.md). Needs the esp-zigbee-lib (main/idf_component.yml) and the partitions
			zb_storage, zb_fct and zb_db. Other chips (the ESP32-S3 has no 802.15.4 radio; the SDK
			is only fetched for the C6 and the H2) build hc_zigbee as a stub whose console command
			says so.

	config HC_ZIGBEE_CHANNEL_MASK
		hex "Channels the network may be formed on (bit n = channel n)"
		depends on HC_ZIGBEE_ENABLED
		default 0x02108000
		help
			Used once, when the network is formed (the stack keeps the chosen channel in zb_storage).
			The default allows channels 15, 20 and 25, which lie between the usual WiFi channels 1, 6
			and 11 (802.15.4 channel 11 is 2405 MHz, every channel 5 MHz higher; a 20 MHz WiFi
			channel covers four of them); the stack picks the quietest by an energy scan. Channel 26
			is left out: some devices transmit with reduced power there.

	config HC_ZIGBEE_PAN_ID
		hex "PAN id (0: chosen by the stack)"
		depends on HC_ZIGBEE_ENABLED
		range 0x0000 0xfffe
		default 0x0000
		help
			The 16-bit PAN id used when the network is formed; 0 lets the stack choose a free one.
			Like the channel it is kept in zb_storage and only changes when the network is formed
			again (erase zb_storage: every device must then be paired again).

	config HC_ZIGBEE_MAX_CHILDREN
		int "Devices that may join the coordinator directly"
		depends on HC_ZIGBEE_ENABLED
		range 1 64
		default 16
		help
			End devices and routers attached to the coordinator itself; more devices join through
			routers (mains-powered devices such as bulbs and plugs).

	config HC_ZIGBEE_TX_POWER
		int "802.15.4 transmit power (dBm)"
		depends on HC_ZIGBEE_ENABLED
		range -24 20
		default 10
		help
			The development C6 browned out on its USB supply with WiFi at 20 dBm (doc/hardware.md);
			10 dBm keeps the 802.15.4 radio in the same range as the WiFi limit of 11 dBm. Raise it
			for a board with a proper supply.

endmenu
```

## platform/esp/updater/main/Kconfig.projbuild
```kconfig
# Copyright (c) 2026 Bernhard Haumacher
#
# The updater does not build hc_net; the options it shares with the application are declared here
# under the same names, and their values come from ../sdkconfig.defaults.

menu "HomeControl network"

	config HC_WIFI_MAX_TX_POWER
		int "Maximum WiFi transmit power (quarter dBm, 8..84)"
		range 8 84
		default 80
		help
			The same limit as the application's (components/hc_net/Kconfig): passed to
			esp_wifi_set_max_tx_power() when the station starts. The project default (44, 11 dBm)
			comes from platform/esp/sdkconfig.defaults; the development C6 browns out at full power
			(doc/hardware.md).

	config HC_WPS_BUTTON_GPIO
		int "GPIO of the WPS button (active low; -1: no button)"
		range -1 48
		default 9 if IDF_TARGET_ESP32C6
		default 0 if IDF_TARGET_ESP32S3
		default -1
		help
			The application's WPS button (components/hc_net/Kconfig). In the updater, while ota_0
			holds no bootable application, holding it for 3 s authorizes an upload from the browser
			for 5 minutes without the one-time token (doc/ota.md "Recovery with the button").

endmenu

menu "HomeControl updater testing"

	config HC_UPDATER_TEST_BUTTON_WINDOW
		bool "TEST ONLY: take the idle path and open the button window without the button"
		default n
		help
			For tests of the recovery path (#69) without erasing the application: the decision
			treats ota_0 as holding no application (so the updater waits idle, as after a broken
			update), and the idle wait acts as if the button had been held for 3 s once the updater
			has run HC_UPDATER_TEST_BUTTON_WINDOW_AFTER_S seconds. An upload then needs no token
			(anyone on the network can flash): never enable it in a build that leaves the desk. The
			updater logs a warning at every boot while it is on. Reach the updater by erasing
			otadata (doc/ota.md, "Testing the recovery path").

	config HC_UPDATER_TEST_BUTTON_WINDOW_AFTER_S
		int "Seconds since boot before the test window opens"
		depends on HC_UPDATER_TEST_BUTTON_WINDOW
		range 0 3600
		default 0

endmenu
```

## spike/blocks-wasm/esp/sdkconfig.defaults.aot
```kconfig
# Copyright (c) 2026 Bernhard Haumacher
# AOT only.
CONFIG_WAMR_ENABLE_AOT=y
# CONFIG_WAMR_ENABLE_INTERP is not set
```

## spike/blocks-wasm/esp/sdkconfig.defaults.classic
```kconfig
# Copyright (c) 2026 Bernhard Haumacher
# Classic interpreter only.
# CONFIG_WAMR_ENABLE_AOT is not set
CONFIG_WAMR_ENABLE_INTERP=y
CONFIG_WAMR_INTERP_CLASSIC=y
```

## spike/blocks-wasm/esp/sdkconfig.defaults.interp
```kconfig
# Copyright (c) 2026 Bernhard Haumacher
# Fast interpreter only.
# CONFIG_WAMR_ENABLE_AOT is not set
CONFIG_WAMR_ENABLE_INTERP=y
CONFIG_WAMR_INTERP_FAST=y
```
